/* nice_view_adapter.overlay — route nice_view over chrumm’s bitbanged bus
 *
 * This assumes:
 *   - spi_view_bus is defined in chrumm/boards/nice_nano_v2.overlay
 *   - nice_view_display node already exists in the base nice_view shield
 *     and we’re just telling Zephyr: "this bus is active and OK".
 */

&spi_view_bus {
    status = "okay";
};

