/*
 * Copyright (c) 2022 The ZMK Contributors
 *
 * SPDX-License-Identifier: MIT
 */

&nice_view_spi {
    status = "okay";
    cs-gpios = <&pro_micro 1 GPIO_ACTIVE_LOW>;
    sci-gpios = <&pro_micro 0 GPIO_ACTIVE_LOW>;
    mosi-gpios =  <&pro_micro 2 GPIO_ACTIVE_LOW>;
    nice_view: ls0xx@0 {
        compatible = "sharp,ls0xx";
        spi-max-frequency = <1000000>;
        reg = <0>;
        width = <160>;
        height = <68>;
    };
};

/ {
    chosen {
        zephyr,display = &nice_view;
    };
};
