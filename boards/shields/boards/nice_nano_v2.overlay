

//595_spi = &pro_micro_spi; 
&pro_micro_spi {
    status = "okay";
    cs-gpios = <&pro_micro 0 GPIO_ACTIVE_LOW>;
    shifter: 595@0 {
        compatible = "zmk,gpio-595";
        status = "okay";
        gpio-controller;
        spi-max-frequency = <200000>; // * 400000 = 4 MHz -    ** originally set to 200000 = 2 MHz (capable of 8 MHz - see note below) - 
        reg = <0>;
        #gpio-cells = <2>;
        ngpios = <8>;
          // *If you have daisy chained multiple shift registers, you'll also want to increase the number of GPIOs that the shift register provides by editing the ngpios node - set this to your number of output pins (should be one of 8, 16, 24, 32). 
          //   * You may also need to increase spi-max-frequency to a higher value if you have daisy chained shift registers, otherwise quick key presses may on occasion not trigger.
          //      - ** The nRF52840 has three low-speed SPI peripherals, SPIM0, SPIM1, and SPIM2 - and one high-speed SPI peripheral, SPIM3. 
          //           - SPIM0, SPIM1 and SPIM2 have a maximum clock rate of 8 MHz, 
          //           - SPIM3 has a maximum clock rate of 32 MHz. 
          //           
          //  ** note - nice_view_spi uses SPIM0.
          //          - pro_micro_spi uses ??not known yet??
    };
};