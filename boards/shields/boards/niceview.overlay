// see zmk 'pin control' page - pin comtrol is needed to set up an spi bus (and a i2c & serial bus)
//     needed for display interfaces and shift-registers

//&pro_micro_spi {
  //  status = "okay";
 //   cs-gpios = <&pro_micro 1 GPIO_ACTIVE_LOW>;
  //  sci-gpios = <&pro_micro 0 GPIO_ACTIVE_LOW>;
  //  mosi-gpios =  <&pro_micro 2 GPIO_ACTIVE_LOW>;

//    shifter: 595@0 {
 //       compatible = "zmk,gpio-595";
//        status = "okay";
 //       gpio-controller;
 //       spi-max-frequency = <200000>;
  //      reg = <0>;
   //     #gpio-cells = <2>;
 //       ngpios = <8>;
  //  };
};


//&pinctrl {
//    /* configuration for spi0 device, default state */
 //   spi0_default: spi0_default {
//        /* node name is arbitrary */
  //      group1 {
  //          /* main role: configure P0.01 as SPI clock, P0.02 as SPI MOSI, P0.03 as SPI MISO */
   //         psels = <NRF_PSEL(SPIM_SCK, 0, 
//                    <NRF_PSEL(SPIM_MOSI, 0, 2)>,
 //                   <NRF_PSEL(SPIM_MISO, 0, 3)>;
 //       };
 //   };

//    /* configuration for spi0 device, sleep state */
//    spi0_sleep: spi0_sleep {
//        group1 {
//            /* main role: configure P0.01 as SPI clock, P0.02 as SPI MOSI, P0.03 as SPI MISO */
//            psels = <NRF_PSEL(SPIM_SCK, 0, 1)>,
//                    <NRF_PSEL(SPIM_MOSI, 0, 2)>,
//                    <NRF_PSEL(SPIM_MISO, 0, 3)>;
//            low-power-enable;
 //       };
//    };
//
//};



&spi0 {
    compatible = "nordic,nrf-spim";
    pinctrl-0 = <&spi0_default>;
    pinctrl-1 = <&spi0_sleep>;
    pinctrl-names = "default", "sleep";
    cs-gpios = <&pro_micro 1 GPIO_ACTIVE_LOW>;
    sci-gpios = <&pro_micro 0 GPIO_ACTIVE_LOW>;
    mosi-gpios =  <&pro_micro 2 GPIO_ACTIVE_LOW>;
};
