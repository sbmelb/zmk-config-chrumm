## boards/shields/chrumm/Kconfig.defconfig
```kconfig
if SHIELD_CHRUMM

config ZMK_KEYBOARD_NAME
    default "Chrumm"

config SPI
    default y

config ZMK_DISPLAY
    bool "Enable ZMK display"
    default y

# Basic LVGL settings (you can tweak later)
config LV_Z_BITS_PER_PIXEL
    int
    default 1

config LV_DPI_DEF
    int
    default 161

config LV_Z_VDB_SIZE
    int
    default 100

config LV_Z_MEM_POOL_SIZE
    int
    default 4096

endif # SHIELD_CHRUMM
```

## boards/shields/chrumm2/Kconfig.defconfig
```kconfig
if SHIELD_CHRUMM

config ZMK_KEYBOARD_NAME
    default "chrumm2"


 CONFIG_EC11=y
 CONFIG_EC11_TRIGGER_GLOBAL_THREAD=y


endif
```
